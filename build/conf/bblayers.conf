## build/conf/bblayers.conf
```bitbake
# POKY_BBLAYERS_CONF_VERSION is increased each time build/conf/bblayers.conf
# changes incompatibly
POKY_BBLAYERS_CONF_VERSION = "2"

BBPATH = "${TOPDIR}"
BBFILES ?= ""

BBLAYERS ?= " \
  /home/dustin/Projects/dev-yocto/ogc_yocto_exploration__stm32mp1/sources/poky/meta \
  /home/dustin/Projects/dev-yocto/ogc_yocto_exploration__stm32mp1/sources/poky/meta-poky \
  /home/dustin/Projects/dev-yocto/ogc_yocto_exploration__stm32mp1/sources/poky/meta-yocto-bsp \
  /home/dustin/Projects/dev-yocto/ogc_yocto_exploration__stm32mp1/sources/meta-openembedded/meta-oe \
  /home/dustin/Projects/dev-yocto/ogc_yocto_exploration__stm32mp1/sources/meta-openembedded/meta-python \
  /home/dustin/Projects/dev-yocto/ogc_yocto_exploration__stm32mp1/sources/meta-st-stm32mp \
  "
```
